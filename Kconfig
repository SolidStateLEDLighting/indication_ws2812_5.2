## Kconfig
```kconfig
menu "WS2812 RGB LED"

    config WS2812_LED_GPIO
        int "WS2812 LED GPIO"
        default 8 if IDF_TARGET_ESP32C3
        default 8 if IDF_TARGET_ESP32C6
        default 48 if IDF_TARGET_ESP32S3
        default 18
        help
            Set the WS2812 RGB LED GPIO.
endmenu
```
